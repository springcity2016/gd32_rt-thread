## Kconfig
```kconfig
mainmenu "RT-Thread Configuration"

config BSP_DIR
    string
    option env="BSP_ROOT"
    default "."

config RTT_DIR
    string
    option env="RTT_ROOT"
    default "rt-thread"
    
# you can change the RTT_ROOT default "rt-thread"
# example : default "F:/git_repositories/rt-thread"

config PKGS_DIR
    string
    option env="PKGS_ROOT"
    default "packages"

source "$RTT_DIR/Kconfig"
source "$PKGS_DIR/Kconfig"

config RT_USING_USART0
    bool "Using USART0"
    select RT_USING_SERIAL
    default y
    
config RT_USING_USART1
    bool "Using USART1"
    select RT_USING_SERIAL
    default n
```
